## drivers/input/Kconfig
```kconfig
config INPUT_TLX493D
    bool "Infineon TLX493D 3D magnetic sensor"
    default y
    depends on I2C
    help
      Enable driver for Infineon TLX493D 3D magnetic sensor.

config INPUT_TLX493D_POLLING_INTERVAL_MS
    int "Polling interval in milliseconds"
    default 10
    range 1 1000
    help
      Interval between sensor readings in milliseconds.

# 以下は削除された設定項目（behavior_z_axis_morphを使用）
# - INPUT_TLX493D_ROTATION_SCALER: 削除（未使用）
# - INPUT_TLX493D_Z_THRESHOLD: 削除（デバイスツリーのz-press-thresholdを使用）
# - POLLING_INTERVAL_MS: 削除（デバイスツリーのpolling-interval-msを使用）
```

## dts/bindings/behaviors/zmk,behavior-z-axis-morph.yaml
```yaml
# Copyright (c) 2025 Manus AI
# SPDX-License-Identifier: Apache-2.0

description: |
  Z-axis state-dependent behavior morph for TLX493D sensor
  
  This behavior switches between different bindings based on the Z-axis
  state (normal/pressed) detected by the TLX493D sensor.
  
  Usage:
    z_axis_morph: z_axis_morph {
        compatible = "zmk,behavior-z-axis-morph";
        bindings = <&mkp MCLK>, <&mkp MCLK &kp LSHIFT>;
    };

compatible: "zmk,behavior-z-axis-morph"

include: one_param.yaml

properties:
  bindings:
    type: phandle-array
    required: true
    description: |
      Array of exactly 2 behaviors:
      - Index 0: Normal state binding (Z-axis not pressed)
      - Index 1: Pressed state binding (Z-axis pressed)
      
```

## dts/bindings/input/infineon,tlx493d-a2bw.yaml
```yaml
description: |
  Infineon TLX493D-A2BW 3D magnetic sensor driver with improved reliability

compatible: "infineon,tlx493d-a2bw"

include: i2c-device.yaml

properties:
  reg:
    required: true
  
  polling-interval-ms:
    type: int
    default: 10
    description: Polling interval in milliseconds
  
  z-press-threshold:
    type: int
    default: 50
    description: Z-axis threshold for press detection
  
  z-hysteresis:
    type: int
    default: 10
    description: Z-axis hysteresis to prevent bounce
  
  # Note: Direct behavior bindings are deprecated
  # Use zmk,behavior-z-axis-morph behavior instead for state-dependent bindings
  # 
  # normal-binding:
  #   type: phandle-array  
  #   specifier-space: zmk,behavior-binding
  #   required: false
  #   description: |
  #     Behavior binding to invoke when sensor is in normal state (Z-axis not pressed).
  #     Example: normal-binding = <&mkp MCLK>;
  # 
  # pressed-binding:
  #   type: phandle-array
  #   specifier-space: zmk,behavior-binding
  #   required: false
  #   description: |
  #     Behavior binding to invoke when sensor is in pressed state (Z-axis pressed).
  #     Example: pressed-binding = <&mkp MCLK &kp LSHIFT>;
```

## dts/bindings/input/infineon,tlx493d.yaml
```yaml
description: |
  Infineon TLX493D-A2BW 3D magnetic sensor driver with improved reliability

compatible: "infineon,tlx493d-a2bw"

include: i2c-device.yaml

properties:
  reg:
    required: true
  
  polling-interval-ms:
    type: int
    default: 10
    description: Polling interval in milliseconds
  
  z-press-threshold:
    type: int
    default: 50
    description: Z-axis threshold for press detection
  
  z-hysteresis:
    type: int
    default: 10
    description: Z-axis hysteresis to prevent bounce
  
  enable-z-state-bindings:
    type: boolean
    description: |
      Enable Z-axis state dependent behavior bindings.
      When true, the driver will invoke behaviors based on Z-axis state.
      Configure behaviors through ZMK behavior system.
```

## src/behaviors/Kconfig
```kconfig
config ZMK_BEHAVIOR_Z_AXIS_MORPH
    bool "Z-axis state dependent behavior morph"
    default n
    help
      Enable Z-axis state dependent behavior morph.
      This behavior switches between two different behaviors based on
      the Z-axis state of a 3D Hall sensor.
      
```
